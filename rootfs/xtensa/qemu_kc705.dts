/dts-v1/;
/include/ "xtfpga.dtsi"
/include/ "xtfpga-flash-128m.dtsi"

/ {
	compatible = "cdns,xtensa-kc705";
	chosen {
		bootargs = "rdinit=/sbin/init earlycon=uart8250,mmio32,0xfd050020,115200n8 console=ttyS0,115200n8";
	};
	memory@0 {
		device_type = "memory";
		reg = <0x00000000 0x38000000>;
	};
};
